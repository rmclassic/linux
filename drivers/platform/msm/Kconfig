## drivers/platform/msm/spmi/Kconfig
```kconfig
menuconfig MSM_SPMI
	bool "SPMI support"
	help
	  SPMI (System Power Management Interface) is a two-wire
	  serial interface between baseband and application processors
	  and Power Management Integrated Circuits (PMIC).
```
